## meta-esme-custom/conf/layer.conf
```bitbake
# We have a conf and classes directory, add to BBPATH
BBPATH .= ":${LAYERDIR}"

# We have recipes-* directories, add to BBFILES
BBFILES += "${LAYERDIR}/recipes-*/*/*.bb \
            ${LAYERDIR}/recipes-*/*/*.bbappend"

BBFILE_COLLECTIONS += "meta-esme-custom"
BBFILE_PATTERN_meta-esme-custom = "^${LAYERDIR}/"
#Priorité changée de 6 à 30
BBFILE_PRIORITY_meta-esme-custom = "30"

LAYERDEPENDS_meta-esme-custom = "core"
LAYERSERIES_COMPAT_meta-esme-custom = "scarthgap"
```

## meta-esme-images/conf/layer.conf
```bitbake
# We have a conf and classes directory, add to BBPATH
BBPATH .= ":${LAYERDIR}"

# We have recipes-* directories, add to BBFILES
BBFILES += "${LAYERDIR}/recipes-*/*/*.bb \
            ${LAYERDIR}/recipes-*/*/*.bbappend"

BBFILE_COLLECTIONS += "meta-esme-images"
BBFILE_PATTERN_meta-esme-images = "^${LAYERDIR}/"
#Priorité changée de 6 à 20
BBFILE_PRIORITY_meta-esme-images = "20"

LAYERDEPENDS_meta-esme-images = "core"
LAYERSERIES_COMPAT_meta-esme-images = "scarthgap"
```
